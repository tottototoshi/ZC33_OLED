#include <Arduino.h>

//ESP32 C3 super mini K2
//OLEDの256ｘ64ピクセル
//7ピンでSPI接続5V駆動
//SH11227ドライバー(withコントローラー)

#include <U8g2lib.h>
#include <U8x8lib.h>
#include <DHT.h>
#include <DHT_U.h>
#include <WiFi.h>
#include <WiFiManager.h> // ★追加：WiFiManagerライブラリ
#include <time.h>
#define JST 3600 * 9                                                       //日本
U8G2_SH1122_256X64_1_4W_HW_SPI u8g2(U8G2_R2, /* cs=*/0, /* dc=*/2, /* reset=*/1);  // Enable U8G2_16BIT in u8g2.h
//SCLはI2Cで言うところのクロックなんでSPIだとSCkで4ピン
//SDAはデータのやり取りマスター出力側のMOSIで6ピン

//起動画面120x45
const unsigned char bootimg[] PROGMEM = {
  0x00, 0x00, 0x00, 0x00, 0x00, 0x00, 0x00, 0x00, 0x00, 0x00, 0x00, 0x00,
  0x00, 0x00, 0x00, 0x00, 0xFE, 0xFF, 0xF9, 0x07, 0x00, 0xE0, 0xEF, 0x1F,
  0x00, 0xFF, 0x3F, 0xFE, 0xFF, 0xFF, 0xC0, 0xFF, 0xFF, 0xF9, 0x87, 0xFF,
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  0x00, 0x00, 0x00, 0x00
};

//℃の表示
const unsigned char doC[] PROGMEM = {
  0x00, 0x00, 0x06, 0x00, 0xC9, 0x03, 0x69, 0x0C, 0x26, 0x10, 0x30, 0x00,
  0x30, 0x00, 0x30, 0x00, 0x70, 0x10, 0x60, 0x08, 0xC0, 0x04, 0x80, 0x03,
  0x00, 0x00
};


//時計の接頭0対応
int hourXpoint;   //時のX描画位置
int minXpoint;    //分のX描画位置
int secXpoint;    //秒のX描画位置
int monthXpoint;  //月のX描画位置
int dayXpoint;    //日のX描画位置

//センサー設定-------------------------------------------
const int PIN_DHT = 7;
DHT dht(PIN_DHT, DHT22);
unsigned long prev;      //周期処理
unsigned long interval;  //周期処理
String te = "--";        //温度
String hu = "--";        //湿度
float prete = 0;         //温度の平均処理
float prehu = 0;         //湿度の平均処理
float preteave = 0;      //温度の平均処理
float prehuave = 0;      //湿度の平均処理

int i = 0;  //センサー平均処理用


// 画面消去関数
void cleardisplay() {
  u8g2.firstPage();
  do {
    u8g2.setDrawColor(0);
    u8g2.drawBox(0, 0, 255, 63);
    u8g2.setDrawColor(1);
  } while (u8g2.nextPage());
}

// ★追加・変更：Wi-Fi設定モード（APモード）に入った時に呼ばれるコールバック関数
void configModeCallback(WiFiManager *myWiFiManager) {
  u8g2.firstPage();
  do {
    u8g2.setFont(u8g_font_timR12);

    // 1行目："Wi-Fi Setup Mode" を中央に配置
    const char* title = "Wi-Fi Setup Mode";
    int titleWidth = u8g2.getStrWidth(title);
    u8g2.drawStr((256 - titleWidth) / 2, 15, title);
    
    // 2行目：スマホで繋ぐべきWi-Fi（SSID）の名前を中央に配置
    String ssidStr = "SSID: " + myWiFiManager->getConfigPortalSSID();
    int ssidWidth = u8g2.getStrWidth(ssidStr.c_str());
    u8g2.setCursor((256 - ssidWidth) / 2, 35);
    u8g2.print(ssidStr);
    
    // 3行目：ブラウザで開くIPアドレスを中央に配置
    // ※WiFiManagerのデフォルトIPは 192.168.4.1 固定です
    String ipStr = "IP: 192.168.4.1";
    int ipWidth = u8g2.getStrWidth(ipStr.c_str());
    u8g2.setCursor((256 - ipWidth) / 2, 55);
    u8g2.print(ipStr);

  } while (u8g2.nextPage());
  
  Serial.println("Entered config mode");
  Serial.println(myWiFiManager->getConfigPortalSSID());
}


void setup() {
  u8g2.begin();

  // ★変更：起動画面の表示
  // WiFi接続処理の前（ここ）で描画しておくことで、接続中は起動画面が維持されます
  u8g2.firstPage();
  do {
    u8g2.drawXBMP(60, 9, 120, 45, bootimg);
  } while (u8g2.nextPage());

  Serial.begin(115200);
  delay(100);
  
  //---------------------------------------------------------
  // WiFiManagerによる接続
  Serial.print("\n\nStart\n");
  
  WiFiManager wm;

  //テスト用リセット命令
  //wm.resetSettings(); // ★この1行を追加して書き込むと記憶が消去される
  
  // Wi-Fi接続のタイムアウト時間を60秒に設定
  wm.setConnectTimeout(60);
  
  // 設定モード（スマホからの入力待ち）のタイムアウト時間を120秒に設定
  wm.setConfigPortalTimeout(120);
  
  // 設定モードに入った時に画面表示を切り替える関数をセット
  wm.setAPCallback(configModeCallback);
  
  // 接続を試みる。「ESP32_Setup」は設定用Wi-Fiの名前
  // 接続完了またはタイムアウトするまでここで処理がブロックされます
  bool res = wm.autoConnect("ESP32_Setup");

  // 120秒の設定モード入力待ちをオーバーした場合
  if (!res) {
    Serial.println("Failed to connect and hit timeout. Restarting...");
    delay(1000);
    ESP.restart(); // ESP32を再起動してやり直す
  }

  // ここに到達したということはWi-Fi接続成功
  Serial.println();
  Serial.printf("Connected, IP address: ");
  Serial.println(WiFi.localIP());
  
//---------------------------------
  // ★変更：WiFi接続完了の表示（中央揃えでSSIDとIPを表示）
  u8g2.firstPage();
  do {
    u8g2.setFont(u8g_font_timR12);

    // 1行目："Connected!" を中央に配置
    const char* title = "Connected!";
    int titleWidth = u8g2.getStrWidth(title);
    u8g2.drawStr((256 - titleWidth) / 2, 20, title);
    
    // 2行目：SSID を中央に配置
    String ssidStr = "SSID: " + WiFi.SSID();
    int ssidWidth = u8g2.getStrWidth(ssidStr.c_str());
    u8g2.setCursor((256 - ssidWidth) / 2, 40);
    u8g2.print(ssidStr);
    
    // 3行目：IPアドレス を中央に配置
    String ipStr = "IP: " + WiFi.localIP().toString();
    int ipWidth = u8g2.getStrWidth(ipStr.c_str());
    u8g2.setCursor((256 - ipWidth) / 2, 60);
    u8g2.print(ipStr);
    
  } while (u8g2.nextPage());
  delay(3000);
  
  //-----------------------------------------------------------
  //時間同期
  configTime(JST, 0, "ntp.nict.jp", "ntp.jst.mfeed.ad.jp");
  
  //-----------------------------------------------------------
  //消去
  cleardisplay();
  delay(1000);

  //----------------------------------------------------------------------
  //センサー開始
  dht.begin();
  
  //--------------------------------------------------------------------
  //センサー読み取り周期処理設定
  prev = 0;         // 前回実行時刻を初期化
  interval = 2000;  // 実行周期を設定
}

void loop() {
  //---------------------------------------------------------------
  //センサー読み取り周期処理開始
  unsigned long curr = millis();    // 現在時刻を取得
  if ((curr - prev) >= interval) {  // 前回実行時刻から実行周期以上経過していたら
    i = i + 1;

    //センサー値取得
    bool isFahrenheit = true;
    float percentHumidity = dht.readHumidity();          //湿度取得
    float temperature = dht.readTemperature();           //温度取得
    if (isnan(percentHumidity) || isnan(temperature)) {  //エラー処理
      Serial.println("ERROR");
      return;
    }

    //10回平均を出す
    if (i <= 10) {                      //9回目までは
      prete = prete + temperature;      //累積していく
      prehu = prehu + percentHumidity;  //累積していく
      Serial.print(i);
      Serial.println(",");
    } else {                       //10回目なら
      preteave = prete / 10 - 1;   //平均する＆補正
      prehuave = prehu / 10 - 10;  //平均する&補正
      te = String(preteave, 1);    //桁揃えした温度を代入
      hu = String(prehuave, 0);    //桁揃えした湿度を代入
      i = 0;
      prete = 0;
      prehu = 0;
      Serial.print(" : ");
      Serial.println(te);
    }
    prev = curr;  // 前回実行時刻を現在時刻で更新
  }
  // 周期処理終了-----------------------------------------------------

  //-------------------------------------------------------------
  //時計処理
  time_t t;                                                                      //time_t型
  struct tm* tm;                                                                 //構造体定義
  static const char* wd[7] = { "Sun", "Mon", "Tue", "Wed", "Thr", "Fri", "Sat" };  //曜日
  t = time(NULL);
  tm = localtime(&t);
  Serial.printf(" %04d/%02d/%02d(%s) %02d:%02d:%02d\n",
                tm->tm_year + 1900, tm->tm_mon + 1, tm->tm_mday,
                wd[tm->tm_wday],
                tm->tm_hour, tm->tm_min, tm->tm_sec);
  delay(1000);

  //表示---------------------------------------------
  u8g2.firstPage();
  do {
    //温度湿度
    u8g2.setFont(u8g_font_timR12);
    u8g2.drawStr(20, 15, "temp");
    u8g2.setCursor(65, 15);
    u8g2.print(te);                     //桁揃え温度表記
    u8g2.drawXBMP(97, 3, 13, 13, doC);  //℃表記
    u8g2.drawStr(135, 15, "humid");
    u8g2.setCursor(185, 15);
    u8g2.print(hu);  //桁揃え湿度表記
    u8g2.drawStr(205, 15, "%");

    //時計
    hourXpoint = 75;   //時X座標
    minXpoint = 140;   //分X座標
    secXpoint = 195;   //秒X座標
    monthXpoint = 25;  //月X座標
    dayXpoint = 42;    //日X座標

    if (tm->tm_hour < 10) {          //時が10以下だったら
      hourXpoint = hourXpoint + 25;  //オフセットさせる
    }
    if (tm->tm_min < 10) {  //分が10以下だったら
      u8g2.setFont(u8g2_font_logisoso38_tf);
      u8g2.drawStr(minXpoint, 63, "0");  //0を接頭させる
      minXpoint = minXpoint + 25;        //オフセットさせる
    }
    if (tm->tm_sec < 10) {  //秒が10以下だったら
      u8g2.setFont(u8g_font_timR12);
      u8g2.drawStr(secXpoint, 60, "0");  //0を接頭させる
      secXpoint = secXpoint + 8;         //オフセットさせる
    }
    if (tm->tm_mon + 1 < 10) {
      monthXpoint = monthXpoint + 5;  //オフセットさせる
    }
    if (tm->tm_mday < 10) {
      dayXpoint = dayXpoint + 5;  //オフセットさせる
    }

    u8g2.setFont(u8g2_font_logisoso38_tf);
    u8g2.setCursor(hourXpoint, 63);  //時
    u8g2.print(tm->tm_hour);
    u8g2.drawStr(125, 63, ":");
    u8g2.setCursor(minXpoint, 63);  //分
    u8g2.print(tm->tm_min);
    u8g2.setFont(u8g_font_timR12);
    u8g2.setCursor(monthXpoint, 42);  //月/日
    u8g2.print(tm->tm_mon + 1);
    u8g2.print(" / ");
    u8g2.print(tm->tm_mday);
    u8g2.setCursor(27, 58);  //曜日
    u8g2.print("(");
    u8g2.print(wd[tm->tm_wday]);
    u8g2.print(")");
    u8g2.setCursor(secXpoint, 60);  //秒
    u8g2.print(tm->tm_sec);
    u8g2.drawLine(15, 18, 220, 18);  //横線

  } while (u8g2.nextPage());
}